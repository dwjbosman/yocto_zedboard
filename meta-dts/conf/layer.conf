## meta-dts/conf/layer.conf
```bitbake
# We have a conf and classes directory, add to BBPATH
BBPATH .= ":${LAYERDIR}"

# We have recipes-* directories, add to BBFILES
BBFILES += "${LAYERDIR}/recipes-*/*/*.bb \
            ${LAYERDIR}/recipes-*/*/*.bbappend"

BBFILE_COLLECTIONS += "meta-dts"
BBFILE_PATTERN_meta-dts = "^${LAYERDIR}/"
BBFILE_PRIORITY_meta-dts = "6"

LAYERSERIES_COMPAT_meta-dts = "sumo"

KERNEL_DEVICETREE_zedboard-zynq7 += "custom-zynq-zed.dtb"
```
