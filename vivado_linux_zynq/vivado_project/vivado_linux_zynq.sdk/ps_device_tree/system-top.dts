/*
 * CAUTION: This file is automatically generated by Xilinx.
 * Version:  
 * Today is: Fri Mar  1 22:51:20 2019
 */


/dts-v1/;
/include/ "zynq-7000.dtsi"
/include/ "pl.dtsi"
/include/ "pcw.dtsi"
/ {
	chosen {
		bootargs = "earlycon";
		stdout-path = "serial0:115200n8";
	};
	aliases {
		ethernet0 = &gem0;
		serial0 = &uart1;
		serial1 = &axi_uartlite_0;
		serial2 = &uart0;
		spi0 = &qspi;
		spi1 = &spi1;
	};
	memory {
		device_type = "memory";
		reg = <0x0 0x20000000>;
	};
};
